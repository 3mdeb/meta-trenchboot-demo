## conf/layer.conf
```bitbake
# We have a conf and classes directory, add to BBPATH
BBPATH .= ":${LAYERDIR}"

# We have recipes-* directories, add to BBFILES
BBFILES += "${LAYERDIR}/recipes-*/*/*.bb \
            ${LAYERDIR}/recipes-*/*/*.bbappend"

BBFILE_COLLECTIONS += "meta-trenchboot-demo"
BBFILE_PATTERN_meta-trenchboot-demo = "^${LAYERDIR}/"
BBFILE_PRIORITY_meta-trenchboot-demo = "6"

LAYERDEPENDS_meta-trenchboot-demo = "core openembedded-layer meta-pcengines meta-trenchboot"
LAYERSERIES_COMPAT_meta-trenchboot-demo = "sumo thud warrior zeus"
```

## wic/xen-router.wks
```
# short-description: Virtualized router
# long-description: Virtualized router

part /boot --source bootimg-pcbios --ondisk sda --label boot --active --align 1024 --use-uuid
part /     --source rootfs --ondisk sda --fstype=ext4 --label rootfsA --align 1024 --use-uuid
part       --source rootfs --ondisk sda --fstype=ext4 --label rottfsB --align 1024 --use-uuid
part /data --source rootfs --ondisk sda --fstype=ext4 --label data    --align 1024 --use-uuid

bootloader --ptable mbt --timeout=0  --append="rootwait console=tty0"
```
